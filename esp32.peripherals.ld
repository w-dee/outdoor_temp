/* providing base addresses due to errata 
 "When the CPU accesses peripherals and writes one address 
repeatedly, random data loss occurs."
*/

PROVIDE ( UART0 = 0x3ff40000 +0x200c0000 );
PROVIDE ( SPI1 = 0x3ff42000 +0x200c0000);
PROVIDE ( SPI0 = 0x3ff43000 +0x200c0000);
PROVIDE ( GPIO = 0x3ff44000 +0x200c0000);
PROVIDE ( SIGMADELTA = 0x3ff44f00 +0x200c0000);
PROVIDE ( RTCCNTL = 0x3ff48000 +0x200c0000);
PROVIDE ( RTCIO = 0x3ff48400 +0x200c0000);
PROVIDE ( SENS = 0x3ff48800 +0x200c0000);
PROVIDE ( UHCI1 = 0x3ff4C000 +0x200c0000);
PROVIDE ( I2S0 = 0x3ff4F000 +0x200c0000);
PROVIDE ( UART1 = 0x3ff50000 +0x200c0000);
PROVIDE ( I2C0 = 0x3ff53000 +0x200c0000);
PROVIDE ( UHCI0 = 0x3ff54000 +0x200c0000);
PROVIDE ( RMT = 0x3ff56000 +0x200c0000);
PROVIDE ( RMTMEM = 0x3ff56800 +0x200c0000);
PROVIDE ( PCNT = 0x3ff57000 +0x200c0000);
PROVIDE ( LEDC = 0x3ff59000 +0x200c0000);
PROVIDE ( MCPWM0 = 0x3ff5E000 +0x200c0000);
PROVIDE ( TIMERG0 = 0x3ff5F000 +0x200c0000);
PROVIDE ( TIMERG1 = 0x3ff60000 +0x200c0000);
PROVIDE ( SPI2 = 0x3ff64000 +0x200c0000);
PROVIDE ( SPI3 = 0x3ff65000 +0x200c0000);
PROVIDE ( SYSCON = 0x3ff66000 +0x200c0000);
PROVIDE ( I2C1 = 0x3ff67000 +0x200c0000);
PROVIDE ( SDMMC = 0x3ff68000 +0x200c0000);
PROVIDE ( MCPWM1 = 0x3ff6C000 +0x200c0000);
PROVIDE ( I2S1 = 0x3ff6D000+0x200c0000 );
PROVIDE ( UART2 = 0x3ff6E000 +0x200c0000);
